
#include "touch-key-backlight-ailsa_ii.dtsi"
#include "zte-camera-sensor-mtp.dtsi" //yichangming 400001

&firmware {
	android {
		compatible = "android,firmware";
		fstab {
			compatible = "android,fstab";
		};
	};
};
